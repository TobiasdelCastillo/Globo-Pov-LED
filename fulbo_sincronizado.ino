#include <FastLED.h>
#define NUM_LEDS 60
#define DATA_PIN 23
#define CLOCK_PIN 22
int infrarrojo=15;
int valor=0;
CRGB leds[NUM_LEDS];

unsigned char i;
unsigned char m;
unsigned int wait = 100;
unsigned int wait2 = 5000;
bool hall = 1;

bool fulbo[28][28] = {


{1,1,1,1,1,1,1,1,1,1,1,1,1,1,1,1,1,1,1,1,1,1,1,1,1,1,1,1},
{1,1,1,1,1,1,1,1,1,1,1,1,1,1,1,1,1,1,1,1,1,1,1,1,1,1,1,1},
{1,1,1,1,1,1,1,1,1,0,1,1,1,1,1,1,1,1,1,1,1,1,1,1,1,1,1,1},
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{1,1,1,1,1,1,1,1,1,1,1,1,1,1,1,1,1,1,1,1,1,1,1,1,1,1,1,1},







 
  
  
  
  
  
  
  
  
};





void setup() {
 
Serial.begin(115200);
  FastLED.addLeds<APA102, DATA_PIN, CLOCK_PIN, BGR>(leds, NUM_LEDS);
  pinMode(infrarrojo, INPUT);





}



void loop() {
  valor= digitalRead(infrarrojo);
  if(valor==LOW){
    
   
    for (m = 0; m < 28; m++) {
      for (i = 0; i < 28; i++) {
        if (fulbo[i][m] == 1) {
          leds[i + 0] = CRGB::Azure;
        }
    if (fulbo[i][m] == 0) {
          leds[i + 0] = CRGB::Black;
        }
       
      }
      FastLED.show();
      delayMicroseconds(wait);
    }


   
  
    for (int i = 0; i < 28; i++) {
      leds[i] = CRGB ::Black;
    }
    FastLED.show();
    delayMicroseconds(wait2);

    
    hall = 1;
  }
}
